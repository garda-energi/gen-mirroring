/*
 * Device tree overlay for Focaltech 6236 touch-screen driver
 *
 * Compile:
 * sudo dtc -@ -I dts -O dtb -o /boot/overlays/ft6236.dtbo ft6236.dts
 */

/dts-v1/;
/plugin/;

/{
    compatible = "brcm,bcm2835", "brcm,bcm2836", "brcm,bcm2708", "brcm,bcm2709";

    fragment@0 {
        target = <&i2c0>;
        __overlay__ {
            #address-cells = <1>;
            #size-cells = <0>;

            ft6236@38 {
                compatible = "focaltech,ft6236";
                reg = <0x38>;
                pinctrl-names = "default";
                interrupt-parent = <&gpio>;
                interrupts = <31 2>; /* rising edge */
                reset-gpios = <&gpio 30 1>; /* active low */
                touchscreen-size-y = <480>;
                touchscreen-size-x = <800>;   
                touchscreen-inverted-x;
                touchscreen-inverted-y;
            };
        };
    };
};
